## Kconfig
```kconfig
# Sensor data simulator
#
# Copyright (c) 2019 Nordic Semiconductor
#
# SPDX-License-Identifier: LicenseRef-Nordic-5-Clause
#

menuconfig PMW3610
    bool "PMW3610 mouse optical sensor"
  select SPI
    help
      Enable PMW3610 mouse optical sensor.

if PMW3610

config PMW3610_SMART_ALGORITHM
  bool "Enable an algorithm of PMW3610 to enhance surface coverage"
  default y
  help
    Enable the integration of the smart algorithm as the datasheet implementation.
    The algorithm is used to extend the tracking acrocss a wider range of surfaces
    such as graniles and tiles.

config PMW3610_DPI_SCALING
  bool "Enable an scaling of PMW3610 raw CPI value to TARGET_CPI value"
  default n
  help
    Enable an scaling of PMW3610 raw CPI value to TARGET_CPI value.

config PMW3610_CPI
    int "PMW3610's default CPI"
    default 800
    range 200 3200
    help
      Default CPI value, with 200 step

config PMW3610_TARGET_CPI
    int "PMW3610's scaling target CPI"
    default 800
    range 100 3100
    help
      Scaling CPI value, with 100 step

config PMW3610_CPI_DIVIDOR
    int "PMW3610's default CPI dividor"
    default 1
    range 1 100
    help
      Default CPI dividor value.

config PMW3610_SNIPE_CPI
    int "PMW3610's CPI in snipe mode"
    default 200
    range 200 3200
    help
      Snipe CPI value, with 200 step

config PMW3610_SNIPE_CPI_DIVIDOR
    int "PMW3610's CPI dividor in snipe mode"
    default 1
    range 1 100
    help
      Snipe CPI dividor value.

config PMW3610_SCROLL_DIVIDOR
    int "PMW3610's scroll mode dividor"
    default 2
    range 1 20
    help
      Dividor value for scroll mode. Higher values make scrolling less sensitive.
      Recommended values:
      - For more sensitive scrolling: 1-2
      - For moderate sensitivity: 3-4
      - For less sensitive scrolling: 5-8

config PMW3610_SCROLL_TICK
    int "PMW3610's required ticks to produce a scroll report"
    default 20
    help
      Scroll tick value. Determines how much accumulated movement is needed
      to generate a scroll event.

config PMW3610_ADJUSTABLE_MOUSESPEED
    bool "Enable Adujutable mouse speed"
    default n

choice
    prompt "Select PMW3610's polling rate"
    default PMW3610_POLLING_RATE_250

config PMW3610_POLLING_RATE_250
    bool "250 Hz"

config PMW3610_POLLING_RATE_125
    bool "125 Hz"

config PMW3610_POLLING_RATE_125_SW
    bool "125 Hz with software implementation"

endchoice

config PMW3610_FORCE_AWAKE
    bool "PMW3610 forced awake mode"
    help
      This setting forces the sensor to always be in the RUN state.

config PMW3610_RUN_DOWNSHIFT_TIME_MS
    int "PMW3610's default RUN mode downshift time"
    default 128
    range 13 3264
    help
      Default RUN mode downshift down time in milliseconds.
      Time after which sensor goes from RUN to REST1 mode.

config PMW3610_REST1_SAMPLE_TIME_MS
    int "PMW3610's sample time in REST1 stage"
    default 40
    range 10 2550
    help
      Default REST1 mode sample period in millisecond

config PMW3610_REST1_DOWNSHIFT_TIME_MS
    int "PMW3610's default REST1 mode downshift time"
    default 9600
    help
      Default REST1 mode downshift down time in milliseconds.
      Time after which sensor goes from REST1 to REST2 mode.

config PMW3610_REST2_SAMPLE_TIME_MS
    int "PMW3610's sample time in REST2 stage"
    default 0
    range 0 2550
    help
      Default REST2 mode sample period in millisecond.
      Minimum value is 10.
      No optimal value provided by datasheet.

config PMW3610_REST2_DOWNSHIFT_TIME_MS
    int "PMW3610's default REST2 mode downshift time"
    default 0
    help
      Default REST2 mode downshift down time in milliseconds.
      Time after which sensor goes from REST2 to REST3 mode.
      No optimal value provided by datasheet.

config PMW3610_REST3_SAMPLE_TIME_MS
    int "PMW3610's sample time in REST3 stage"
    default 0
    range 0 2550
    help
      Default REST2 mode sample period in millisecond.
      Minimum value is 10.
      No optimal value provided by datasheet.

choice
    prompt "Select PMW3610 sensor orientation"
    default PMW3610_ORIENTATION_0

config PMW3610_ORIENTATION_0
    bool "PMW3610 not rotated"

config PMW3610_ORIENTATION_90
    bool "PMW3610 rotated 90 deg clockwise"

config PMW3610_ORIENTATION_180
    bool "PMW3610 rotated 180 deg clockwise"

config PMW3610_ORIENTATION_270
    bool "PMW3610 rotated 270 deg clockwise"

endchoice

config PMW3610_INVERT_X
  bool "Invert the X axis of PMW3610 sensor"

config PMW3610_INVERT_Y
  bool "Invert the Y axis of PMW3610 sensor"

config PMW3610_INVERT_SCROLL_X
  bool "Invert the X axis of the scroll"
  default PMW3610_INVERT_X

config PMW3610_INVERT_SCROLL_Y
  bool "Invert the Y axis of the scroll"
  default PMW3610_INVERT_Y

config PMW3610_AUTOMOUSE_TIMEOUT_MS
  int "Amount of milliseconds the mouse layer will be active after using the trackball"
  default 500
  help
    Time in milliseconds the mouse layer remains active after the last detected movement.
    Increasing this value gives more time to perform actions like clicking before the layer
    is deactivated. Default is 500ms (increased from 400ms).

config PMW3610_AUTOMOUSE_PIXEL_THRESHOLD
  int "Pixel threshold for switch to mouse layer"
  default 50

config PMW3610_MOVEMENT_THRESHOLD
    int "Movement threshold for automatic mouse layer activation"
    default 5
    help
        The threshold for trackball movement that triggers the automatic mouse layer.
        A higher value means more movement is required to activate the mouse layer.
        This helps prevent accidental activation during typing.

config PMW3610_MOVEMENT_ACCUMULATION_TIME_MS
    int "Time window in milliseconds for accumulating trackball movement"
    default 100
    help
        The time window in milliseconds during which trackball movement is accumulated
        before comparing to the threshold. Longer times allow for slower movements
        to trigger the mouse layer.

config PMW3610_INTENTIONAL_MOVEMENT_DETECTION
    bool "Enable intentional movement pattern detection"
    default y
    help
        Enables detection of intentional movement patterns to distinguish
        between actual trackball usage and vibration-induced movement.
        This helps balance immediate layer switching with vibration immunity.

config PMW3610_MOVEMENT_TIMEOUT_EXTENSION
    bool "Enable automatic extension of mouse layer timeout on continued movement"
    default y
    help
        When enabled, the mouse layer will remain active as long as
        there is continued movement, preventing premature deactivation.

config PMW3610_SMOOTHING_FILTER
    bool "Enable movement smoothing filter"
    default n
    help
        Enables a smoothing filter that reduces jitter and improves precision
        for small movements while maintaining responsiveness for larger movements.

config PMW3610_SMOOTHING_WEIGHT
    int "Smoothing filter weight (percentage)"
    depends on PMW3610_SMOOTHING_FILTER
    default 40
    range 0 90
    help
        The weight given to previous movement samples in the smoothing filter.
        Higher values result in smoother cursor movement but may introduce lag.
        Lower values make the cursor more responsive but may be less smooth.
        Range is 0-90 percent, with 0 effectively disabling smoothing
        and 90 applying maximum smoothing.

menuconfig PMW3610_PROFILE_SWITCHING
    bool "Enable mouse profile switching"
    default n
    help
        Enables support for switching between different mouse profiles (precision, regular, speed)
        triggered by keys or layers.

if PMW3610_PROFILE_SWITCHING

config PMW3610_PRECISION_PROFILE_CPI
    int "CPI for precision profile"
    default 200
    range 200 3200
    help
        The CPI setting to use when in precision profile mode.
        Lower values are better for precise movements.

config PMW3610_PRECISION_PROFILE_SMOOTHING
    int "Smoothing weight for precision profile"
    default 70
    range 0 90
    depends on PMW3610_SMOOTHING_FILTER
    help
        The smoothing weight to apply in precision mode.
        Higher values (60-80) recommended for precision work.

config PMW3610_SPEED_PROFILE_CPI
    int "CPI for speed profile"
    default 1200
    range 200 3200
    help
        The CPI setting to use when in speed profile mode.
        Higher values are better for quick cursor movements.

config PMW3610_SPEED_PROFILE_SMOOTHING
    int "Smoothing weight for speed profile"
    default 20
    range 0 90
    depends on PMW3610_SMOOTHING_FILTER
    help
        The smoothing weight to apply in speed mode.
        Lower values (10-30) recommended for fast movements.

endif # PMW3610_PROFILE_SWITCHING

module = PMW3610
module-str = PMW3610
source "${ZEPHYR_BASE}/subsys/logging/Kconfig.template.log_config"

endif #PMW3610
```
